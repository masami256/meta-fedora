## conf/distro/fedy.inc
```bitbake
DISTRO_NAME = "Fedy"
DISTRO_VERSION = "30"
DISTRO_CODENAME = "f30"
SDK_VENDOR = "-fedysdk"
SDK_VERSION := "${DISTRO_VERSION}"

MAINTAINER = "masami256"
TARGET_VENDOR = "-fedy"

# Add an eventhandler that generates FEDORA_SRC_URI information
# from Fedora rpm repository
INHERIT += "fedora-source"

# currently only Fedora 28 is tested
SANITY_TESTED_DISTROS ?= " \
fedora-28 \n \
fedora-29 \n \
"
# use toolchain mode for Fedora instead of the default
TCMODE ?= "fedy"

FEDORA_MIRROR = "http://ftp.iij.ad.jp"

# Use host's rpm2cpio
HOSTTOOLS += "rpm2cpio"

# systemd

# preferred providers and versions
require conf/distro/include/fedora-preferred-provider.inc
DISTRO_FEATURES_append = " systemd"
DISTRO_FEATURES_BACKFILL_CONSIDERED += "sysvinit"
VIRTUAL-RUNTIME_init_manager = "systemd"
VIRTUAL-RUNTIME_initscripts = "systemd-compat-units"
VIRTUAL-RUNTIME_udev = "systemd-udev"
```

## conf/distro/include/fedora-preferred-provider.inc
```bitbake
PREFERRED_PROVIDER_virtual/kernel = "linux-fedora"
PREFERRED_PROVIDER_linux-libc-headers = "linux-libc-headers-fedora"
PREFERRED_PROVIDER_nativesdk-linux-libc-headers = "nativesdk-linux-libc-headers-fedora"
```

## conf/layer.conf
```bitbake
# We have a conf and classes directory, add to BBPATH
BBPATH =. "${LAYERDIR}:"

# We have recipes-* directories, add to BBFILES
BBFILES += "${LAYERDIR}/recipes-*/*/*.bb \
            ${LAYERDIR}/recipes-*/*/*.bbappend"

BBFILE_COLLECTIONS += "fedora"
BBFILE_PATTERN_fedora = "^${LAYERDIR}/"
BBFILE_PRIORITY_fedora = "10"

# This should only be incremented on significant changes that will
# cause compatibility issues with other layers
LAYERVERSION_fedora = "1"

LAYERDEPENDS_fedora = "core"

LAYERSERIES_COMPAT_fedora = "warrior"

# Set a variable to keep the path of layer meta-fedora
LAYERDIR_FEDORA_fedora = '${@os.path.normpath("${LAYERDIR}")}'
```
